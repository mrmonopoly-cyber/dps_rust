VERSION "1.0"

NS_ :

BS_:

BU_: MASTER SLAVE

BO_ 650 DpsSlaveMex: 8 SLAVE
 SG_ board_id : 0|4@1+ (1,0) [0|15] "slave board id" MASTER
 SG_ Mode M : 4|4@1+ (1,0) [0|15] "slave mex type" MASTER
 SG_ boardName m0 : 12|52@1+ (1,0) [0|0] "slave board name" MASTER
 SG_ infoVarId m1 : 8|4@1+ (1,0) [0|15] "slave var id" MASTER
 SG_ varName m1 : 16|48@1+ (1,0) [0|0] "slave var name" MASTER
 SG_ valueVarId m2 : 8|4@1+ (1,0) [0|15] "slave var id" MASTER
 SG_ valueVarType m2 : 12|2@1+ (1,0) [0|2] "slave var type" MASTER
 SG_ valueVarSize m2 : 14|2@1+ (1,0) [0|2] "slave var size" MASTER
 SG_ varId m3 : 8|4@1+ (1,0) [0|15] "slave var id" MASTER
 SG_ value m3 : 16|32@1+ (1,0) [0|2] "slave var value" MASTER

BO_ 651 DpsMasterMex: 8 MASTER
 SG_ Mode M : 0|4@1+ (1,0) [0|15] "master mex type" SLAVE
 SG_ reserved m0 : 4|4@1+ (1,0) [0|15] "" SLAVE
 SG_ varName_boardId m1 : 4|4@1+ (1,0) [0|15] "master board id" SLAVE
 SG_ varMetadataBoardId m2 : 4|4@1+ (1,0) [0|15] "master board id" SLAVE
 SG_ varMetadataVarId m2 : 8|4@1+ (1,0) [0|15] "master var id" SLAVE
 SG_ varValue_boardId m3 : 4|4@1+ (1,0) [0|15] "master board id" SLAVE
 SG_ varValue_var_id m3 : 8|4@1+ (1,0) [0|15] "master var id" SLAVE
 SG_ updateVarValue_boardId m4 : 4|4@1+ (1,0) [0|15] "master board id" SLAVE
 SG_ updateVarValue_var_id m4 : 8|4@1+ (1,0) [0|15] "master var id" SLAVE
 SG_ updateVarValue_varValue m4 : 12|32@1+ (1,0) [0|15] "new master var value" SLAVE

VAL_ 650 valueVarType 0 "SignedInteger" 1 "UnsignedInteger" 2 "Float";
VAL_ 650 valueVarSize 0 "8Bit" 1 "16Bit" 2 "32Bit";

SG_MUL_VAL_ 650 id Mode 0-0;
SG_MUL_VAL_ 650 boardName Mode 0-0;
SG_MUL_VAL_ 650 varId Mode 3-3;
SG_MUL_VAL_ 650 varName Mode 1-1;
SG_MUL_VAL_ 650 valueVarType Mode 2-2;
SG_MUL_VAL_ 650 valueVarSize Mode 2-2;
SG_MUL_VAL_ 650 value Mode 3-3;
SG_MUL_VAL_ 651 reserved Mode 0-0;
SG_MUL_VAL_ 651 Mode None 0-0;
SG_MUL_VAL_ 651 varNameBoard_id Mode 1-1;
SG_MUL_VAL_ 651 varMetadataBoard_id Mode 2-2;
SG_MUL_VAL_ 651 varMetadataVar_id Mode 2-2;
SG_MUL_VAL_ 651 varValueVoardId Mode 3-3;
SG_MUL_VAL_ 651 varValueVarId Mode 3-3;
SG_MUL_VAL_ 651 value Mode 3-3;
